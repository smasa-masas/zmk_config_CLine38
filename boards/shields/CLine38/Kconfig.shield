## boards/shields/CLine38/Kconfig.shield
```kconfig
config SHIELD_CLINE38_R
    def_bool $(shields_list_contains,CLine38_R)

config SHIELD_CLINE38_L
    def_bool $(shields_list_contains,CLine38_L)
```
